;-----------------------------------------------------------------------------------------------------------------------
;  Name:    instance.cmm
;  Version: 27.09.2022, Notz                                                                Copyright (c) 2020, STW
;
;  Description: This script implements the "derivate" interface for TC367 derivates
;
;  Target:      TriCore AURIX generic
;-----------------------------------------------------------------------------------------------------------------------

local &args
local &event

entry %LINE &args
   &event = string.split("&args"," ",0)

   if (&event=="describe_mcu")
   (
      gosub describe_mcu &args
   )

   if (&event=="prepare_mcu")
   (
      gosub prepare_mcu &args
   )

   if (&event=="startup_memory_protect_begin")
   (
      rpc all_cpus map.denyAccess 0xf0000000--0xffffffff ; Peripherals (SRI)
      intercom.wait all
   )

   if (&event=="startup_memory_protect_end")
   (
      rpc all_cpus map.noDenyAccess 0xf0000000--0xffffffff ; Peripherals (SRI)
      intercom.wait all
   )

   enddo

describe_mcu:
(
   local &args
   local &fblMode       &fblOp
   local &fbl2Mode      &fbl2Op
   local &unlockFlash   &unlockFlash
   local &brickMode2000
   local &normOp
   local &ucbOp
   entry %LINE &args

   &fblMode       = string.scanAndExtract(string.lower("&args"),"fblmode=","false()")
   &fbl2Mode      = string.scanAndExtract(string.lower("&args"),"fbl2mode=","false()")
   &unlockFlash   = string.scanAndExtract(string.lower("&args"),"unlockflash=","false()")
   &brickMode2000 = string.scanAndExtract(string.lower("&args"),"brickmode2000=","false()")

   ; Unlock flashloader sectors if called with fblmode=true()
   if &fblMode
      &fblOp = "TARGET"
   else
      &fblOp = "NOP"

   ; Unlock 2ndlevel flashloader sectors if called with fbl2mode=true()
   if &fbl2Mode
      &fbl2Op = "TARGET"
   else
      &fbl2Op = "NOP"

   ; Do not allow flashing of application reserved sectors in flashloader modes
   if &fblMode||&fbl2Mode
      &normOp = "NOP"
   else
      &normOp = "TARGET"

   if &unlockFlash
   (
      &fblOp  = "TARGET"
      &fbl2Op = "TARGET"
      &normOp = "TARGET"
   )

   if &brickMode2000
   (
      print "Brickmode 2000 detected!"
      &ucbOp  = "TARGET"
   )
   else
   (
      &ucbOp  = "NOP"
   )

   ; Program flash PF0 2MiB [0xA0000000, 0xA0200000[
   flash.create  1. 0xA0000000--0xA003FFFF  0x4000 &fblOp  Long 0. /INFO "Flash Loader" ; PS0
   flash.create  1. 0xA0040000--0xA005FFFF  0x4000 &fbl2Op Long 0. /INFO "Reserved (2nd level/HSM)"
   flash.create  1. 0xA0060000--0xA0063FFF  0x4000 &normOp Long 0. /INFO "Boot Sector Core0"
   flash.create  1. 0xA0064000--0xA0067FFF  0x4000 &normOp Long 0. /INFO "Boot Sector Core1"
   flash.create  1. 0xA0068000--0xA00FFFFF  0x4000 &normOp Long 0.
   flash.create  2. 0xA0100000--0xA01FFFFF  0x4000 &normOp Long 0. ; PS1

   ; Program flash PF1 2MiB  (0xA0300000--0xA04FFFFF)
   flash.create  3. 0xA0300000--0xA03FFFFF  0x4000 &normOp Long 1. ; PS0
   flash.create  4. 0xA0400000--0xA04FFFFF  0x4000 &normOp Long 1. ; PS1

   ; Use on-chip resources for breakpoints inside the whole flash range
   rpc all_cpus map.bonchip      0x80000000--0x801FFFFF ; PF0
   rpc all_cpus map.bonchip      0xA0000000--0xA01FFFFF ; PF0
   rpc all_cpus map.bonchip      0x80300000--0x804FFFFF ; PF1
   rpc all_cpus map.bonchip      0xA0300000--0xA04FFFFF ; PF1

   ; Data flash DF0 1MiB (currently defaulting to single-ended mode!)
   flash.create  5. 0xAF000000--0xAF01FFFF  0x1000 &normOp Long /INFO "EEPROM0" ; DF0, EEPROM0..31
   flash.create  6. 0xAF400000--0xAF405FFF   0x200 &ucbOp  Long /INFO "UCBs"    ; DF0, UCB

   ; Data flash DF1 128 KiB (currently defaulting to single-ended mode!)
   flash.create  7. 0xAFC00000--0xAFC1FFFF  0x1000 &normOp Long /INFO "EEPROM1" ; DF1, EEPROM0..31

   ; Create alias for cached address space
   flash.createAlias 0x80000000--0x8FFFFFFF 0xA0000000

   flash.target 0xC0000000 0xD0000000 0x4000 ~~~~/../lauterbach/tc3.bin /DualPort

   ; Now deny access to memory map gaps (large ones, and ones that are close to memories the user might look at)
   rpc all_cpus map.denyAccess 0x00000000--0x5FFFFFFF       ; Segment 0 .. Absent cores
   rpc all_cpus map.denyAccess 0x60034000--0x600BFFFF       ; Reserved
   rpc all_cpus map.denyAccess 0x600C1800--0x600FFFFF       ; Reserved
   rpc all_cpus map.denyAccess 0x60110000--0x601BFFFF       ; Reserved
   rpc all_cpus map.denyAccess 0x601C3000--0x6FFFFFFF       ; Reserved
   rpc all_cpus map.denyAccess 0x70034000--0x700BFFFF       ; Reserved
   rpc all_cpus map.denyAccess 0x700C1800--0x700FFFFF       ; Reserved
   rpc all_cpus map.denyAccess 0x70110000--0x701BFFFF       ; Reserved
   rpc all_cpus map.denyAccess 0x701C3000--0x7FFFFFFF       ; Reserved
   rpc all_cpus map.denyAccess 0x80200000--0x802FFFFF       ; Reserved
   rpc all_cpus map.denyAccess 0x80500000--0x8FFEFFFF       ; Reserved
   rpc all_cpus map.denyAccess 0x90020000--0x9FFFFFFF       ; Reserved
   rpc all_cpus map.denyAccess 0xA0200000--0xA02FFFFF       ; Reserved
   rpc all_cpus map.denyAccess 0xA0500000--0xA7FFFFFF       ; Reserved
   rpc all_cpus map.denyAccess 0xA8004000--0xA807FFFF       ; Reserved
   rpc all_cpus map.denyAccess 0xA8100000--0xA82FFFFF       ; Reserved
   rpc all_cpus map.denyAccess 0xA8304000--0xA837FFFF       ; Reserved
   rpc all_cpus map.denyAccess 0xA8400000--0xAEFFFFFF       ; Reserved
   rpc all_cpus map.denyAccess 0xAF020000--0xAF3FFFFF       ; Reserved
   rpc all_cpus map.denyAccess 0xAF406000--0xAF7FFFFF       ; Reserved
   rpc all_cpus map.denyAccess 0xAF810000--0xAFBFFFFF       ; Reserved
   rpc all_cpus map.denyAccess 0xAFC20000--0xAFFEFFFF       ; Reserved
   rpc all_cpus map.denyAccess 0xB0020000--0xBFFFFFFF       ; Reserved

   if &fblMode
   else
      rpc all_cpus map.denyAccess 0x80000040--0x800000FF       ; Gap between bmhd+entry and startaddress (for unfilled hex)
      rpc all_cpus map.denyAccess 0xA0000040--0xA00000FF       ; Gap between bmhd+entry and startaddress (uncached)

   return
)

prepare_mcu:
(
   print "prepare_mcu(tc367): preparing mcu"

   ; Disable Watchdog Timers
   map.noDenyAccess 0xF0036000--0xF00363FF      ; Allow SCU access
   per.set.simple D:0xF00362AC %Long 0x00000008 ; SCU_WDTSCON1,    Request to disable the safety watchdog
   per.set.simple D:0xF0036250 %Long 0x00000008 ; SCU_WDTCPU0CON1, Request to disable the cpu0 watchdog
   per.set.simple D:0xF003625C %Long 0x00000008 ; SCU_WDTCPU1CON1, Request to disable the cpu1 watchdog

   ; stop STM on break
   map.noDenyAccess 0xf0001000--0xf00015ff      ; Allow STM access
   per.set   0xF00010E8 %LONG 0x12000000        ; enable STM0 suspend
   per.set   0xF00011E8 %LONG 0x12000000        ; enable STM1 suspend

   ; ... also on each spontaneous reset
   data.startup.sequence \
      set 0xF00010E8 %LONG 0x12000000 \
      set 0xF00011E8 %LONG 0x12000000
   data.startup.on

   return
)
