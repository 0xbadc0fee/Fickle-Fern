   print "Reset detected."

   do prepare_mcu
   go main

   enddo